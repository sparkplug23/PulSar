#include "SPIFFSEditor.h"
#include <FS.h>

// array size is 4120
#define edit_htm_gz_len 4120
static const byte edit_htm_gz[] PROGMEM  = {
  0x1f, 0x8b, 0x08, 0x00, 0x00, 0x00, 0x00, 0x00, 0x02, 0x03, 0xb5, 0x3a, 0x0b, 0x5b, 0xda, 0xc8, 
  0xda, 0x7f, 0x85, 0xa6, 0x67, 0xdd, 0xe4, 0x10, 0x02, 0xa8, 0x75, 0xdb, 0x60, 0x74, 0x41, 0x6d, 
  0x6d, 0xbd, 0x0b, 0xb4, 0xb5, 0x9e, 0x7e, 0xfb, 0x0c, 0xc9, 0x00, 0xa3, 0xc9, 0x4c, 0x9a, 0x0c, 
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  0x62, 0xe9, 0xfb, 0x8c, 0x7f, 0x29, 0x00, 0x00
};

#define SPIFFS_MAXLENGTH_FILEPATH 32

/* Exclusion list feature not needed and omitted */

// WEB HANDLER IMPLEMENTATION

SPIFFSEditor::SPIFFSEditor(const fs::FS& fs, const String& username, const String& password)
:_fs(fs)
,_username(username)
,_password(password)
,_authenticated(false)
,_startTime(0)
{}

#ifdef ESP8266
SPIFFSEditor::SPIFFSEditor(const String& username, const String& password, const fs::FS& fs) : SPIFFSEditor(fs, username, password) {};
#endif

bool SPIFFSEditor::canHandle(AsyncWebServerRequest *request){
  if(request->url().equalsIgnoreCase(F("/edit"))){
    if(request->method() == HTTP_GET){
      if(request->hasParam("list"))
        return true;
      if(request->hasParam("edit")){
        if (request->arg("edit").indexOf("wsec") > -1) return false; //make sure wsec.json is not served
        request->_tempFile = _fs.open(request->arg("edit"), "r");
        if(!request->_tempFile){
          return false;
        }
#ifdef ESP32
        if(request->_tempFile.isDirectory()){
          request->_tempFile.close();
          return false;
        }
#endif
      }
      if(request->hasParam(F("download"))){
        if (request->arg(F("download")).indexOf("wsec") > -1) return false; //make sure wsec.json is not served
        request->_tempFile = _fs.open(request->arg(F("download")), "r");
        if(!request->_tempFile){
          return false;
        }
#ifdef ESP32
        if(request->_tempFile.isDirectory()){
          request->_tempFile.close();
          return false;
        }
#endif
      }
      request->addInterestingHeader(F("If-Modified-Since"));
      return true;
    }
    else if(request->method() == HTTP_POST)
      return true;
    else if(request->method() == HTTP_DELETE)
      return true;
    else if(request->method() == HTTP_PUT)
      return true;

  }
  return false;
}


void SPIFFSEditor::handleRequest(AsyncWebServerRequest *request){
  if(_username.length() && _password.length() && !request->authenticate(_username.c_str(), _password.c_str()))
    return request->requestAuthentication();

  if(request->method() == HTTP_GET){
    if(request->hasParam("list")){
      String path = request->getParam("list")->value();
#ifdef ESP32
      File dir = _fs.open(path);
#else
      Dir dir = _fs.openDir(path);
#endif
      path = String();
      String output = "[";
#ifdef ESP32
      File entry = dir.openNextFile();
      while(entry){
#else
      while(dir.next()){
        fs::File entry = dir.openFile("r");
#endif
        String fname = entry.name();
        if (fname.indexOf("wsec") == -1) {
          if (output != "[") output += ',';
          output += F("{\"type\":\"file\",\"name\":\"");
          if (fname[0] != '/') output += '/';
          output += fname;
          output += F("\",\"size\":");
          output += String(entry.size());
          output += '}';
        }
#ifdef ESP32
        entry = dir.openNextFile();
#else
        entry.close();
#endif
      }
#ifdef ESP32
      dir.close();
#endif
      output += ']';
      request->send(200, FPSTR(CONTENT_TYPE_JSON), output);
      output = String();
    }
    else if(request->hasParam("edit") || request->hasParam(F("download"))){
      request->send(request->_tempFile, request->_tempFile.name(), String(), request->hasParam(F("download")));
    }
    else {
      const char * buildTime = __DATE__ " " __TIME__ " GMT";
      if (request->header(F("If-Modified-Since")).equals(buildTime)) {
        request->send(304);
      } else {
        AsyncWebServerResponse *response = request->beginResponse_P(200, FPSTR(CONTENT_TYPE_HTML), edit_htm_gz, edit_htm_gz_len);
        response->addHeader(F("Content-Encoding"), F("gzip"));
        response->addHeader(F("Last-Modified"), buildTime);
        request->send(response);
      }
    }
  } else if(request->method() == HTTP_DELETE){
    if(request->hasParam("path", true)){
        _fs.remove(request->getParam("path", true)->value());
      request->send(200, "", "DELETE: "+request->getParam("path", true)->value());
    } else
      request->send(404);
  } else if(request->method() == HTTP_POST){
    if(request->hasParam("data", true, true) && _fs.exists(request->getParam("data", true, true)->value()))
      request->send(200, "", "UPLOADED: "+request->getParam("data", true, true)->value());
    else
      request->send(500);
  } else if(request->method() == HTTP_PUT){
    if(request->hasParam("path", true)){
      String filename = request->getParam("path", true)->value();
      if(_fs.exists(filename)){
        request->send(200);
      } else {
        fs::File f = _fs.open(filename, "w");
        if(f){
          f.write((uint8_t)0x00);
          f.close();
          request->send(200, "", "CREATE: "+filename);
        } else {
          request->send(500);
        }
      }
    } else
      request->send(400);
  }
}

void SPIFFSEditor::handleUpload(AsyncWebServerRequest *request, const String& filename, size_t index, uint8_t *data, size_t len, bool final){
  if(!index){
    if(!_username.length() || request->authenticate(_username.c_str(),_password.c_str())){
      _authenticated = true;
      request->_tempFile = _fs.open(filename, "w");
      _startTime = millis();
    }
  }
  if(_authenticated && request->_tempFile){
    if(len){
      request->_tempFile.write(data,len);
    }
    if(final){
      request->_tempFile.close();
    }
  }
}
